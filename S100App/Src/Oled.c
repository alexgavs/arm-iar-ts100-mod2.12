/********************* (C) COPYRIGHT 2015 e-Design Co.,Ltd. **********************
File Name :      Oled.c
Version :        S100 APP Ver 2.11
Description:
Author :         Celery
Data:            2015/07/07
History:
2015/07/07   Unified naming
*******************************************************************************/

#include <stdio.h>
#include <string.h>
#include "APP_Version.h"
#include "Oled.h"
#include "Bios.h"
#include "I2C.h"
#include "HARDWARE.h"
#include "DISK.h"
#include "UI.h"

const u8 tel[] = {
0x00,0xE0,0xF8,0xFC,0x3C,0x1C,0xFC,0xF8,0xF8,0xE0,0x00,0xFC,0xDC,0x5C,0xDC,0xEC,
0xDC,0xDC,0x84,0x00,0xF0,0xF8,0xFC,0x1C,0x1C,0xFC,0xF8,0xF0,0x80,0x60,0xF8,0xFC,
0xFC,0x9C,0x9C,0xFC,0xF8,0xE0,0x00,0x80,0xC0,0xE0,0xB8,0xFC,0xFC,0xFC,0x80,0x00,
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0x3C,0x38,0x3F,0x1F,0x0F,0x03,0x04,0x1E,0x3E,0x38,0x78,0x3D,0x3F,0x1F,0x0F,0x00, 
};

const u8 logo[]={
0x00,0x00,0x00,0x00,0xC0,0xE0,0xF8,0xF8,0xFC,0xFC,0x7E,0x3E,0x1E,0x1F,0x0F,0x0F,
0x0F,0x0F,0x0F,0x0F,0x0F,0x8F,0x8F,0x8F,0x8F,0x8E,0x8E,0x9E,0x9E,0x8C,0x8C,0x84,
0x00,0x80,0xC0,0xE0,0xF0,0xF8,0xFC,0xFC,0xF9,0x33,0x07,0x0F,0x1F,0x3F,0x7F,0xFF,
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0xF3,0xF3,0xF3,0xF3,0xF3,0x7F,0x7F,0x7F,0x3F,0x3F,0x3F,0x1F,0x1E,0x0C,0x00,0x00,
};

const u8 Mini[] = {/*12*16*/
    0x00,0x00,0x00,0x00,0x00,0x00,0x00,0x00,0x00,0x00,0x00,0x00,0x00,0x00,0x00,0x00,
    0x00,0x00,0x00,0x00,0x00,0x00,0x00,0x00,0x80,0xC0,0xE0,0xF0,0xF8,0xFC,0xFE,0xFE,
    0xFC,0xF8,0xF0,0xE0,0xC0,0x80,0xC0,0xE0,0xF0,0xF8,0xFC,0xFE,0xFE,0xFE,0xFC,0x78,
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    0x00,0x00,0x00,0x00,0x00,0x00,0x00,0x00,0x00,0x00,0x00,0x00,0x00,0x00,0x00,0x00,/*"D:\yinyongqin\烙铁界面\LOGOIN.BMP.bmp",0*/
};
const u8 Seeed[] = {/*12*16*/
    0x00,0x00,0x00,0x00,0x00,0x00,0x00,0xC0,0x80,0x00,0x00,0xC0,0xF8,0x38,0x04,0x00,
    0x04,0x38,0xF8,0xC0,0x00,0x00,0x80,0xC0,0x00,0x00,0x00,0x00,0x00,0x00,0xE0,0x30,
    0x10,0x10,0x10,0x10,0x10,0x20,0x00,0x00,0x80,0xC0,0x60,0x30,0x10,0x10,0x10,0x30,
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    0x10,0x20,0x20,0x20,0x20,0x10,0x18,0x7F,0x00,0x00,0x00,0x00,0x00,0x00,0x00,0x00,/*"D:\yinyongqin\烙铁界面\LOGOIN.ddMP.bmp",0*/
};
#ifdef SSD1316
u8 gOled_param[50] = {  0x80,0xAE,0x80,0x00,0x80,0x10,0x80,0x40,0x80,0xB0,0x80,
                        0x81,0x80,0xFF,0x80,0xA0,0x80,0xA6,0x80,0xA8,0x80,0x1F,
                        0x80,0xC8,0x80,0xD3,0x80,0x00,0x80,0xD5,0x80,0x80,0x80,
                        0xD9,0x80,0x22,0x80,0xDA,0x80,0x12,0x80,0xDB,0x80,0x40,
                        0x80,0x8D,0x80,0x14,0x80,0xAF,
                     };
#else
#ifdef LEFTHAND
//Down for left hand
u8 gOled_param[46] = {  0x80,0xAE,0x80,0xD5,0x80,0x52,0x80,0xA8,0x80,0x0f,0x80,
                        0xC8,0x80,0xD3,0x80,0x00,0x80,0x40,0x80,0xA1,0x80,0x8D,
                        0x80,0x14,0x80,0xDA,0x80,0x02,0x80,0x81,0x80,0x33,0x80,
                        0xD9,0x80,0xF1,0x80,0xDB,0x80,0x30,0x80,0xA4,0x80,0XA6,
                        0x80,0xAF
                     };
#else
//Up for Right Hand                     
u8 gOled_param[46] = {  0x80,0xAE,0x80,0xD5,0x80,0x52,0x80,0xA8,0x80,0x0f,0x80,
                        0xC0,0x80,0xD3,0x80,0x00,0x80,0x40,0x80,0xA0,0x80,0x8D,
                        0x80,0x14,0x80,0xDA,0x80,0x02,0x80,0x81,0x80,0x33,0x80,
                        0xD9,0x80,0xF1,0x80,0xDB,0x80,0x30,0x80,0xA4,0x80,0XA6,
                        0x80,0xAF
                     };

#endif
#endif

/*******************************************************************************
Function name: Sc_Pt
Function Action: Screen saver changes the screen contrast
Input parameters: Co screen contrast parameter
Return parameter: NULL
*******************************************************************************/
void Sc_Pt(u8 Co) //屏幕保护
{
    u8 pt[4] = {0x80,0x81,0x80,Co};

    I2C_PageWrite(pt,4,DEVICEADDR_OLED);
}
/*******************************************************************************
Function name: Oled_DisplayOn
Function: Open the OLED display
Input parameters: NULL
Return parameter: NULL
*******************************************************************************/
void Oled_DisplayOn(void)
{
    u8 data[6] = {0x80,0X8D,0x80,0X14,0x80,0XAF};

    I2C_PageWrite(data,6,DEVICEADDR_OLED);
}
/*******************************************************************************
Function name: Oled_DisplayOff
Function Function: Turn off the OLED display
Input parameters: NULL
Return parameter: NULL
*******************************************************************************/
void Oled_DisplayOff(void)
{
    u8 data[6] = {0x80,0X8D,0x80,0X10,0x80,0XAE};

    I2C_PageWrite(data,6,DEVICEADDR_OLED);
}

/*******************************************************************************
Function name: Data_Command
Function Action: Pass the displayed width and the displayed input to the OLED
Input parameters: wide, ptr library pointer
Return parameter: the next library pointer
*******************************************************************************/

u8* Data_Command(u8 wide,u8* ptr)
{
    int i;
    u8 tx_data[128];

    tx_data[0] = 0x40;
    wide += 1;
    for(i = 1; i < wide; i++)  tx_data[i] = *ptr++;
    I2C_PageWrite(tx_data,wide,DEVICEADDR_OLED);
    return ptr;
}

/************************************************* ******************************
Function name: Set_ShowPos
Function Function: The location where the content is to be displayed
Input parameters: x: abscissa, y: ordinate (0,8,16,24)
Return parameter: NULL
*******************************************************************************/

void Set_ShowPos(u8 x,u8 y)
{
    u8 pos_param[8] = { 0x80,0xB0,0x80,0x21,0x80,0x20,0x80,0x7F };
#ifdef LEFTHAND
    pos_param[5] = x;
#else
    pos_param[5] = x + 32;
#endif
    pos_param[1] += y;

    I2C_PageWrite(pos_param,8,DEVICEADDR_OLED);
}


/*******************************************************************************
Function name: Oled_DrawArea
Function: Displays a region
Input parameters: x0: start abscissa
牋牋牋牋牋 Y0: initial ordinate (0,8,16,24)
牋牋牋牋牋 Wide: Displays the width of the content
牋牋牋牋牋 High: Displays the content height
牋牋牋牋牋 Ptr: Displays the contents of the library pointer
Return parameter: the next library pointer
*******************************************************************************/
u8* Oled_DrawArea(u8 x0,u8 y0,u8 wide, u8 high,u8* ptr)
{
    u8 m,n,y;

    n = y0 + high;
    if(y0 % 8 == 0) m = y0 / 8;
    else            m = y0 / 8 + 1;

    if(n % 8 == 0)  y = n / 8;
    else            y = n / 8 + 1;

    for(; m < y; m++) {
        Set_ShowPos(x0,m);
        ptr = Data_Command(wide,ptr);
    }
    return ptr;
}



/*******************************************************************************
Function name: Clean_Char
Function Function: Clear the length of the wide position for the screen at k
Input parameters: Clear the position wide for the clear width
Return parameter: NULL
*******************************************************************************/
void Clean_Char(int k,u8 wide)
{
    int i;
    u8 tx_data[128];

    memset(&tx_data[0],0,wide);
    for(i = 0; i < 2; i++) {
        Oled_DrawArea(k,i * 8,wide,8,tx_data);
    }
}
/*******************************************************************************
函数名: GPIO_Init_OLED
函数作用:初始化LED端口
输入参数:NULL
返回参数:NULL
*******************************************************************************/
void GPIO_Init_OLED(void)
{
    GPIO_InitTypeDef GPIO_InitStructure;

    GPIO_InitStructure.GPIO_Pin   = OLED_RST_PIN;
    GPIO_InitStructure.GPIO_Speed = GPIO_Speed_50MHz;
    GPIO_InitStructure.GPIO_Mode  = GPIO_Mode_Out_PP;
    GPIO_Init(GPIOB, &GPIO_InitStructure);
}
/*******************************************************************************
Function name: Init_Oled
Function Action: Initialize LED settings
Input parameters: NULL
Return parameter: NULL
*******************************************************************************/
void Init_Oled(void)
{
    u8 param_len;

    OLED_RST();
    Delay_Ms(2);
    OLED_ACT();
    Delay_Ms(2);

#ifdef SSD1316
    param_len = 50;
#else
    param_len = 46;
#endif

    I2C_PageWrite((u8 *)gOled_param,param_len,DEVICEADDR_OLED);
}

/*******************************************************************************
Function name: Clear_Screen
Function function: clear screen
Input parameters: NULL
Return parameter: NULL
*******************************************************************************/
void Clear_Screen(void)
{
    u8 tx_data[128];
    u8 i,wd;

#ifdef SSD1316
    wd = 32;
#else
    wd = 16;
#endif

    memset(&tx_data[0],0,128);
    for(i = 0; i < wd / 8; i++) {
        Oled_DrawArea(0,i * 8,128,8,tx_data);
    }
}
/*******************************************************************************
Function name: Display_BG
Function Action: Search and display a picture named LOGOIN.BMP
Input parameters: NULL
Return parameter: NULL
*******************************************************************************/
void  Display_BG(void)
{
    u8 i,j,k,m,n,p,ch,Palette = 1;
    u8* bmpfile;
    u16 filelen;
    u16* Root_addr = 0;
    u8 *ptr = 0;
    u8 g_au8TxData[128];

    if(bmpfile = SearchFile("LOGOIN  BMP",&filelen,Root_addr)) {
        if(bmpfile[0] == 'B' && bmpfile[1] == 'M' ) {
            if((bmpfile[0x36] == 0xFF) && (bmpfile[0x37] == 0xFF) && (bmpfile[0x38] == 0xFF)) {
                Palette = 0;
            }
            memset(&g_au8TxData[1],0,127);
            p = 0x1;
            for(i = 15; i >= 8; i--) {
                m = 0;
                for(j = 0; j < 12; j++) {
                    ch = bmpfile[0x3E + i * 12 + j];
                    n = 0x80;
                    for(k = 0; k < 8; k++) {
                        if(Palette) {
                            if(!(ch & n)) g_au8TxData[m + 1] |= p;
                        } else {
                            if((ch & n))  g_au8TxData[m + 1] |= p;
                        }
                        m++;
                        n >>= 1;
                    }
                }
                p <<= 1;
            }
            Oled_DrawArea(0,0,96,8,g_au8TxData);
            Clear_Watchdog();

            memset(&g_au8TxData[1],0,127);
            p = 0x1;
            for(i = 0; i < 8; i++) {
                m = 0;
                for(j = 0; j < 12; j++) {
                    ch = bmpfile[0x3E + (7 - i) * 12 + j];
                    n = 0x80;
                    for(k = 0; k < 8; k++) {
                        if(Palette) {
                            if(!(ch & n)) g_au8TxData[m + 1] |= p;
                        } else {
                            if((ch & n))  g_au8TxData[m + 1] |= p;
                        }
                        m++;
                        n >>= 1;
                    }
                }
                p <<= 1;
            }
            Oled_DrawArea(0,8,96,8,g_au8TxData);
            Delay_Ms(1000);
            Clear_Watchdog();
            return;
        }
    } else {
#ifdef MFTSEEED
        ptr = (u8*)Seeed;
#else
        ptr = (u8*)logo ; // Mini; 
#endif
        Oled_DrawArea(0,0,96,16,ptr);
        Delay_Ms(1000);
        Clear_Watchdog();
    }
}

/******************************** END OF FILE *********************************/

